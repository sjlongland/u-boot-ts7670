## arch/arm/mach-imx/mxs/Kconfig
```kconfig
if ARCH_MX23

config MX23
	bool
	default y

choice
	prompt "MX23 board select"
	optional

config TARGET_MX23_OLINUXINO
	bool "Support mx23_olinuxino"
	select PL01X_SERIAL
	select BOARD_EARLY_INIT_F

config TARGET_MX23EVK
	bool "Support mx23evk"
	select PL01X_SERIAL
	select BOARD_EARLY_INIT_F

endchoice

config SYS_SOC
	default "mxs"

source "board/olimex/mx23_olinuxino/Kconfig"
source "board/nxp/mx23evk/Kconfig"

endif

if ARCH_MX28

config MX28
	bool
	default y

choice
	prompt "MX28 board select"
	optional

config TARGET_BTT
	bool "Support BTT"
	select PL01X_SERIAL
	imply OF_UPSTREAM

config TARGET_MX28EVK
	bool "Support mx28evk"
	select PL01X_SERIAL
	select BOARD_EARLY_INIT_F

config TARGET_TS7400_V2
	bool "Support TS-7400 v2"
	select PL01X_SERIAL
	select BOARD_EARLY_INIT_F

config TARGET_TS7553
	bool "Support TS-7553 v2"
	select PL01X_SERIAL
	select BOARD_EARLY_INIT_F

config TARGET_TS7670B
	bool "Support TS-7670 rev B"
	select PL01X_SERIAL
	select BOARD_EARLY_INIT_F

config TARGET_TS7670D
	bool "Support TS-7670 rev D"
	select PL01X_SERIAL
	select BOARD_EARLY_INIT_F

config TARGET_TS7680
	bool "Support TS-7680"
	select PL01X_SERIAL
	select BOARD_EARLY_INIT_F

config TARGET_TS7695
	bool "Support TS-7695"
	select PL01X_SERIAL
	select BOARD_EARLY_INIT_F

config TARGET_XEA
	bool "Support XEA"
	select PL01X_SERIAL

endchoice

config SYS_SOC
	default "mxs"

config SPL_MXS_PMU_MINIMAL_VDD5V_CURRENT
	bool "Force minimal current draw from VDD5V by MX28 PMU"
	help
	  After setting this option, the current drawn from VDD5V
	  by the PMU is reduced to zero - the DCDC_BATT is used as
	  the main power source for PMU.

config SPL_MXS_PMU_DISABLE_BATT_CHARGE
	bool "Disable Battery Charging in MX28 PMU"

config SPL_MXS_PMU_ENABLE_4P2_LINEAR_REGULATOR
	bool "Enable the 4P2 linear regulator in MX28 PMU"
	default y
	help
	  This option enables the 4P2 linear regulator (derived
	  from VDD5V) - so the VDD4P2 power source is operational.

source "board/nxp/mx28evk/Kconfig"
source "board/liebherr/btt/Kconfig"
source "board/liebherr/xea/Kconfig"

endif
```

## board/technologic/ts7670d/Kconfig
```kconfig
if TARGET_TS7670D

config SYS_BOARD
	default "ts7670d"

config SYS_VENDOR
	default "technologic"

config SYS_SOC
	default "mxs"

config SYS_CONFIG_NAME
	default "ts7670d"

choice
	prompt "Environment file location"
	default TARGET_TS7670_ENV_LOCATION_CN3

config TARGET_TS7670_ENV_LOCATION_CN3
	bool "SD card in socket CN3"

config TARGET_TS7670_ENV_LOCATION_EMMC
	bool "eMMC"

config TARGET_TS7670_ENV_LOCATION_CUSTOM
	bool "Custom"

endchoice

if TARGET_TS7670_ENV_LOCATION_CN3
config TARGET_TS7670_ENV_LOCATION_INTERFACE
	default "mmc"

config TARGET_TS7670_ENV_LOCATION_DEVICE_AND_PART
	default "0:2"
endif

if TARGET_TS7670_ENV_LOCATION_EMMC
config TARGET_TS7670_ENV_LOCATION_INTERFACE
	default "mmc"

config TARGET_TS7670_ENV_LOCATION_DEVICE_AND_PART
	default "1:2"
endif

if TARGET_TS7670_ENV_LOCATION_CUSTOM

config TARGET_TS7670_ENV_LOCATION_INTERFACE
	string "Environment location interface"
	default "mmc"

config TARGET_TS7670_ENV_LOCATION_DEVICE_AND_PART
	string "Environment location device:partition"
	default "0:2"

endif

config TARGET_TS7670_ENV_LOCATION_FILENAME
	string "Environment location filename"
	default "/u-boot.env"

endif
```

## configs/ts7670d_defconfig
```kconfig
CONFIG_ARM=y
CONFIG_ARCH_MX28=y
CONFIG_TEXT_BASE=0x40002000
CONFIG_SYS_MALLOC_F_LEN=0x400
CONFIG_SPL_GPIO=y
CONFIG_SPL_LIBCOMMON_SUPPORT=y
CONFIG_SPL_LIBGENERIC_SUPPORT=y
CONFIG_NR_DRAM_BANKS=1
CONFIG_ENV_SIZE=0x4000
CONFIG_IMX_CONFIG=""
CONFIG_DM_GPIO=y
CONFIG_DEFAULT_DEVICE_TREE="imx28-ts7670d"
CONFIG_TARGET_TS7670D=y
CONFIG_SPL_SERIAL=y
CONFIG_SPL_TEXT_BASE=0x00001000
CONFIG_SYS_LOAD_ADDR=0x42000000
CONFIG_SPL=y
CONFIG_FIT=y
CONFIG_USE_BOOTCOMMAND=y
CONFIG_BOOTCOMMAND="run sdboot; run emmcboot;"
CONFIG_SYS_CONSOLE_IS_IN_ENV=y
# CONFIG_DISPLAY_BOARDINFO is not set
CONFIG_MISC_INIT_R=y
# CONFIG_SPL_FRAMEWORK is not set
CONFIG_SPL_NO_BSS_LIMIT=y
CONFIG_HUSH_PARSER=y
CONFIG_SYS_MAXARGS=32
# CONFIG_CMD_CONSOLE is not set
CONFIG_CMD_BOOTZ=y
CONFIG_BOOTM_NETBSD=y
CONFIG_BOOTM_OPENRTOS=y
CONFIG_CMD_BIND=y
CONFIG_CMD_FUSE=y
CONFIG_CMD_GPIO=y
CONFIG_CMD_GPIO_READ=y
CONFIG_CMD_I2C=y
CONFIG_CMD_MMC=y
CONFIG_CMD_PART=y
CONFIG_CMD_USB=y
CONFIG_CMD_WDT=y
CONFIG_CMD_DHCP=y
CONFIG_CMD_DNS=y
CONFIG_CMD_MII=y
CONFIG_CMD_PING=y
CONFIG_CMD_WGET=y
CONFIG_CMD_CACHE=y
CONFIG_CMD_INI=y
CONFIG_CMD_EXT4=y
CONFIG_CMD_EXT4_WRITE=y
CONFIG_CMD_FAT=y
CONFIG_CMD_FS_GENERIC=y
CONFIG_CMD_FS_UUID=y
CONFIG_CMD_DIAG=y
CONFIG_OF_CONTROL=y
CONFIG_DEVICE_TREE_INCLUDES="imx28-ts7670d-u-boot.dtsi"
CONFIG_ENV_OVERWRITE=y
CONFIG_ENV_IS_IN_EXT4=y
CONFIG_ENV_EXT4_INTERFACE="mmc"
CONFIG_ENV_EXT4_DEVICE_AND_PART="0:2"
CONFIG_ENV_EXT4_FILE="/u-boot.env"
CONFIG_ENV_RELOC_GD_ENV_ADDR=y
CONFIG_USE_BOOTFILE=y
CONFIG_BOOTFILE="uImage"
CONFIG_VERSION_VARIABLE=y
CONFIG_NET_LWIP=y
CONFIG_SPL_DM=y
CONFIG_MXS_GPIO=y
CONFIG_DM_I2C=y
CONFIG_DM_I2C_GPIO=y
CONFIG_MXS_OCOTP=y
CONFIG_MMC_BROKEN_CD=y
CONFIG_MMC_MXS=y
CONFIG_DM_MDIO=y
CONFIG_FEC_MXC=y
CONFIG_MII=y
CONFIG_RMII=y
CONFIG_PHYLIB=y
CONFIG_PHY_SMSC=y
CONFIG_PINCTRL=y
CONFIG_PINCTRL_MXS=y
CONFIG_DM_REGULATOR=y
CONFIG_DM_REGULATOR_FIXED=y
CONFIG_DM_REGULATOR_GPIO=y
CONFIG_RTC_MXS=y
CONFIG_DM_SERIAL=y
CONFIG_USB=y
CONFIG_USB_EHCI_HCD=y
CONFIG_USB_STORAGE=y
CONFIG_WDT=y
CONFIG_WDT_TSWDT=y
CONFIG_LZO=y
```
